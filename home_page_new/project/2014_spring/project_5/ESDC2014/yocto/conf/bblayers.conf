## home_page_new/project/2014_spring/project_5/ESDC2014/yocto/conf/bblayers.conf
```bitbake
# LAYER_CONF_VERSION is increased each time build/conf/bblayers.conf
# changes incompatibly
LCONF_VERSION = "6"

BBPATH = "${TOPDIR}"
BSPDIR = "${TOPDIR}"
BBFILES ?= ""

BBLAYERS ?= " \
  /home/edward/ESDC/poky/meta \
  /home/edward/ESDC/poky/meta-yocto \
  /home/edward/ESDC/poky/meta-yocto-bsp \
  /home/edward/ESDC/meta-valleyisland-dylan-1.4.2/meta-intel \
  /home/edward/ESDC/meta-valleyisland-dylan-1.4.2/meta-intel/meta-isg/meta-valleyisland \
  /home/edward/ESDC/meta-oe/meta-oe \
"
BBLAYERS_NON_REMOVABLE ?= " \
  /home/edward/ESDC/poky/meta \
  /home/edward/ESDC/poky/meta-yocto \
  "
```
